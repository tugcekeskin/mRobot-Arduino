#include "MeOrion.h"
MeDCMotor motor(M1); // motor definition
MeDCMotor motor2(M2); // motor definition
MeUltrasonicSensor ultraSensor(PORT_7); // ultrasonic sensor definition

// commands that run once when the program runs for the first time
void setup() {
  Serial.begin(9600); // serial port is set to 9600 baud   
}

void loop() {
  float distance = ultraSensor.distanceCm(); // distance unit which is taken from the sensor (cm)
  Serial.print("Distance: ");
  Serial.print(distance);
  Serial.println(" cm");
  delay(100); // latency time, 100 milliseconds
  int leftWheel = -255; // first motor
  int rightWheel = 255; // second motor
  
  if (distance > 150) { // distance is greater than 150 cm, started
    motor.run(leftWheel);
    motor2.run(rightWheel);
  }
  
  else if (distance > 120 && distance <= 150) { // distance is greater than 120 cm and is less than or equal to 150 cm, decelerated
    motor.run(leftWheel+30);
    motor2.run(rightWheel-30);
  }

  else if (distance > 90 && distance <= 120) { // distance is greater than 90 cm and is less than or equal to 120 cm, decelerated
    motor.run(leftWheel+60);
    motor2.run(rightWheel-60);
  }
  
  else if (distance > 60 && distance <= 90) { // distance is greater than 60 cm and is less than or equal to 90 cm, decelerated
    motor.run(leftWheel+90);
    motor2.run(rightWheel-90);
  }

  else if (distance > 30 && distance <= 60) { // distance is greater than 30 cm and is less than or equal to 60 cm, decelerated
    motor.run(leftWheel+120);
    motor2.run(rightWheel-120);
  }
  
  else if (distance > 10 && distance <= 30 ) { // distance is greater than 10 cm and is less than or equal to 30 cm, decelerated
    motor.run(leftWheel+150);
    motor2.run(rightWheel-150);
  }
  
  else if (distance > 0 && <= 10) { // distance is greater than 0 cm and is less than or equal to 10 cm, stopped
    motor2.stop();
    
    exit(0); // code completed successfully, exit program
  }   
}
